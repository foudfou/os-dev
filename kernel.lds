/**
 * Kernel basic linker script, following the OSDev wiki on
 * https://wiki.osdev.org/Bare_Bones.
 *
 * man in `info ld Scripts`
 */

/** Starts execution at the '_start' symbol as defined in `boot.s`. */
ENTRY(_start)


/** Sections layout. */
SECTIONS
{
    /**
     * Kernel's booting code could be loaded starting at 1MiB address by the
     * bootloader by convention.
     */
    . = 0x100000;

    /* Take note of the beginning of the kernel. This only makes sense if
       output supports symbol, like elf, unlike binary! */
    PROVIDE(__k_start = .);

    /* _k_virtual_offset = 0; */
    _k_virtual_offset = 0x80000000;

    . += _k_virtual_offset;

    .text : AT (ADDR (.text) - _k_virtual_offset)
    {
        KEEP(*(.multiboot))     /** Put multiboot header before code. */
        *(.text)
        *(.comment)
    }

    .rodata : /* AT (ADDR (.rodata) - _k_virtual_offset) */
    {
        *(.rodata)
    }

    /* Adjust the address for the data segment to the next page */
    . = ALIGN(0x1000);

    .data : /* AT (ADDR (.data) - _k_virtual_offset) */
    {
        *(.data)
    }

    .bss : /* AT (ADDR (.bss) - _k_virtual_offset)w */
    {
        *(.bss)     /** Includes our 16KiB temporary stack. */
        *(COMMON)
    }

    /* Take note of the end of the kernel */
    PROVIDE(__k_end = .);

    /* We don't care of the note, indent, comment, etc.. sections generated by gcc */
    /DISCARD/ :{
        *(.note*)
        *(.indent)
        *(.comment)
        *(.stab)
        *(.stabstr)
    }
}
